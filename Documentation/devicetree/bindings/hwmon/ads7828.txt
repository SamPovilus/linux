## Documentation/devicetree/bindings/hwmon/ads7828.txt
```
ads7828 properties

Required properties:
- compatible:
	Should be one of
	       ti,ads7828
	       ti,ads7830
- reg: I2C address

Optional properties:

- differential-input
  Set to use the device in differential mode.
- vref
  The external reference on the device is set to this regulators output. If it
  does not exists the internal reference will be used and output by the chip
  on the pin.
```
